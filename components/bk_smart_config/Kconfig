## components/bk_smart_config/Kconfig
```kconfig
# KCONFIG_GROUP: Solution & Product
menu "BK Smart Config"
	config BK_SMART_CONFIG
		bool "Enable beken sramt config module"
		default y

	config BK_MODEM_POWER_ON
		int "GPIO used to power on the 4G module"
		depends on BK_MODEM
		default 21
		range 0 255
		help
		  Power-enable GPIO of the 4G module, driven high to switch on
		  the +4V2 rail (P4G_EN). Robot V2 = 21, Robot R2 = 26.
endmenu
```

## components/video_engine/Kconfig
```kconfig
# KCONFIG_GROUP: Solution & Product
menu "video_engine"

	config BK_VIDEO_ENGINE
	bool "enable video engine"
	default y
		
	choice VIDEO_ENGINE_USE_CAMERA_TYPE
		prompt "Select video engine use camera type"
		default VIDEO_ENGINE_USE_DVP_CAMERA

		config VIDEO_ENGINE_USE_DVP_CAMERA
		bool "Select DVP camera"
		help
			Select DVP camera

		config VIDEO_ENGINE_USE_MIPI_CAMERA
		bool "Select MIPI CSI camera"
		depends on ISP && MIPI_CSI && CSI_CAMERA
		help
			Select BK7259 MIPI CSI camera through ISP and H.264 encoder.

		config VIDEO_ENGINE_USE_UVC_CAMERA
		bool "Select UVC camera"
		help
			Select UVC camera
	endchoice

	choice VIDEO_ENGINE_IMAGE_FORMAT
		prompt "Select video engine image format"
		default VIDEO_ENGINE_JPEG_FORMAT

		config VIDEO_ENGINE_JPEG_FORMAT
		bool "Select JPEG image format"
		help
			Select JPEG image format

		config VIDEO_ENGINE_H264_FORMAT
		bool "Select H264 image format"
		help
			Select H264 image format
	endchoice

	config VIDEO_ENGINE_RESOLUTION_WIDTH
	int "Default size of the width"
	range 1 2000
	default 1280
	help
		Set the size of the resolution width, The recommended value is 1280 .

	config VIDEO_ENGINE_RESOLUTION_HEIGHT
	int "Default size of the height"
	range 1 2000
	default 720
	help
		Set the size of the resolution height, The recommended value is 720 .

	config VIDEO_ENGINE_MIPI_CAM_SCL
	int "MIPI camera I2C SCL GPIO"
	depends on VIDEO_ENGINE_USE_MIPI_CAMERA
	range 0 71
	default 70
	help
		GPIO used as the MIPI camera I2C SCL.
		The default is the Robot V2 pin (GPIO70); override it in the
		project defconfig when the board uses different pins.

	config VIDEO_ENGINE_MIPI_CAM_SDA
	int "MIPI camera I2C SDA GPIO"
	depends on VIDEO_ENGINE_USE_MIPI_CAMERA
	range 0 71
	default 71
	help
		GPIO used as the MIPI camera I2C SDA.
		The default is the Robot V2 pin (GPIO71); override it in the
		project defconfig when the board uses different pins.

	config VIDEO_ENGINE_MIPI_CAM_I2C_ID
	int "MIPI camera I2C controller ID"
	depends on VIDEO_ENGINE_USE_MIPI_CAMERA
	range 0 2
	default 1
	help
		I2C controller the MIPI camera is attached to.
		The default follows Robot V2 (I2C ID 1).

	config VIDEO_ENGINE_MIPI_SENSOR_WIDTH
	int "MIPI sensor width"
	depends on VIDEO_ENGINE_USE_MIPI_CAMERA
	range 1 2000
	default 1280
	help
		Set the MIPI sensor input width.

	config VIDEO_ENGINE_MIPI_SENSOR_HEIGHT
	int "MIPI sensor height"
	depends on VIDEO_ENGINE_USE_MIPI_CAMERA
	range 1 2000
	default 720
	help
		Set the MIPI sensor input height.

	config VIDEO_ENGINE_MIPI_SENSOR_FPS
	int "MIPI sensor FPS"
	depends on VIDEO_ENGINE_USE_MIPI_CAMERA
	range 1 120
	default 25
	help
		Set the MIPI sensor input frame rate.

endmenu
```

## projects/beken_muse/ap/Kconfig.projbuild
```kconfig
menu "BEKEN GENIE demo Configuration"
    config LDO3V3_ENABLE
        bool "Enabel LDO_3V3"
        default n

    config HARDWARE_SPEAKER_VER
        int "select HARDWARE_SPEAKER_VER"
        range 0 8
        default 0

    config ROBOT_TEST
        bool "Enable ROBOT_TEST (beken_generated page nav custom code)"
        default y
        help
            When enabled, the build defines ROBOT_TEST=1 so that #if ROBOT_TEST blocks
            in page_N_init.c (navigation hooks, ui_nav_register_screen, etc.) are compiled.
            Disable only if you need a build without that custom code.

    menu "Muse Gadget (experimental)"
        config MUSE_GADGET
            bool "Enable Muse Gadget minimum integration"
            default n
            select PSA_MBEDTLS
            select WEBSOCKET
            select WEBSOCKET_TLS
            help
                Build the isolated Muse community-pairing and Noise control
                service. The feature is headless and must be started explicitly.
                It does not replace the existing provisioning or AI chat paths.

        config MUSE_GADGET_SDK_TOKEN
            string "Muse Gadget SDK token"
            default ""
            depends on MUSE_GADGET
            help
                Build-time mgst_ token used only by encrypted pairing and token
                mint/refresh requests. Do not commit a real token or print it.

        config MUSE_GADGET_NOISE_HOST
            string "Muse Noise host"
            default "hatch.metaaivm.com"
            depends on MUSE_GADGET

        config MUSE_GADGET_CA_PATH
            string "Muse TLS CA PEM path"
            default "/sd0/muse_ca.pem"
            depends on MUSE_GADGET
            help
                VFS path to the PEM trust anchor loaded by `muse start`.
                The file is copied into RAM and certificate verification
                remains mandatory. Use `muse ca-load <path>` to override it.

        config MUSE_GADGET_VOICE
            bool "Enable Muse push-to-talk voice (experimental)"
            default n
            depends on MUSE_GADGET
            help
                Record mic audio on demand (S4 long-press toggle or
                `muse voice`), stream 16 kHz PCM to the Muse VM over the
                Noise voice stream and show the transcript/reply on the
                panel. The wire format is an assumption pending protocol
                confirmation (docs/muse_voice_design.md section 2.2).

        config MUSE_ASR_VOLC
            bool "Volcano streaming ASR (v3 SAUC) voice turns"
            default n
            depends on MUSE_GADGET_VOICE
            help
                Route mic PCM to the Volcano bigmodel streaming recognizer
                and send the final transcript to Muse as a text note
                (bypasses Muse's server-side ASR). Requires the speech
                service activated in the volc console and its runtime
                credentials via `muse volcappid/asrkey` -- never bake
                credentials into the build.

        config MUSE_ASR_VOLC_RESOURCE_ID
            string "Volcano ASR resource id (model/edition)"
            default "volc.bigasr.sauc.duration"
            depends on MUSE_ASR_VOLC
            help
                2.0 duration edition: volc.seedasr.sauc.duration;
                1.0: volc.bigasr.sauc.duration. Concurrent editions use
                *.concurrent. Must match an activated service on the key.

        config MUSE_TTS_VOLC
            bool "Volcano TTS for assistant replies"
            default n
            depends on MUSE_GADGET_VOICE
            help
                Synthesize each assistant reply via the Volcano TTS
                bidirectional-streaming websocket (v3, 豆包语音合成大模型)
                to an MP3 on the SD-NAND and play it through the
                prompt-tone mix port (16 kHz matches the voice engine
                rate). Uses the runtime `muse ttskey` credential (X-Api-Key
                or old-console token), never baked into the build.

        config MUSE_TTS_VOLC_RESOURCE_ID
            string "Volcano TTS resource id (model/edition)"
            default "seed-tts-2.0"
            depends on MUSE_TTS_VOLC
            help
                2.0: seed-tts-2.0; 1.0 char edition: volc.service_type.10029;
                voice-clone: seed-icl-2.0 / seed-icl-1.0. Must match the
                service activated in the volc console -- a 1.0 id against a
                2.0-only account gets 403 at the upgrade (2026-11-12).

        config MUSE_TTS_VOLC_VOICE
            string "Volcano TTS speaker id (see console voice library)"
            default "zh_female_xiaohe_uranus_bigtts"
            depends on MUSE_TTS_VOLC
            help
                Must belong to the same model generation as the resource id:
                seed-tts-2.0 only accepts 2.0 voices (*_uranus_bigtts); the
                jupiter/moon families are 1.0 and get rejected with
                "resource ID is mismatched with speaker related resource"
                (field 2026-11-12). Runtime override: `muse ttsvoice <id>`.

        config MUSE_TTS_VOLC_OUT_PATH
            string "TTS output MP3 path (must be on a mounted volume)"
            default "/sd0/tts_volc.mp3"
            depends on MUSE_TTS_VOLC

        config MUSE_VOICE_MAX_RECORD_MS
            int "Voice max record duration (ms)"
            default 30000
            depends on MUSE_GADGET_VOICE

        config MUSE_VOICE_REPLY_TIMEOUT_MS
            int "Voice reply wait timeout (ms)"
            default 180000
            depends on MUSE_GADGET_VOICE

        config MUSE_VOICE_REPLY_SHOW_MS
            int "Voice reply display duration (ms)"
            default 30000
            depends on MUSE_GADGET_VOICE

        config MUSE_NOTE_REPLY_HINT
            string "In-band hint sent in every note's message field"
            default "请通过 display.draw_text 把文字回复发到设备屏幕上；用户要图片时用 display.draw_url 把图片发到设备屏幕上，图片按 385x320 横屏尺寸生成，直接生成发送无需向我确认"
            depends on MUSE_GADGET_VOICE
            help
                Muse pushes a reply to the board via device.invoke only
                when the VM was told to (it is conversational behaviour,
                not a protocol flag — Muse support, 2026-10). Baking the
                instruction into each note's message field makes the push
                reliable without relying on chat history. Empty disables.

        config MUSE_NOTE_SEND_SESSION_ID
            bool "Send session_id in note heads (target a side chat)"
            default n
            depends on MUSE_GADGET_VOICE
            help
                A client-supplied session_id routes the note into THAT
                side chat; an id the server has not seen starts a new
                conversation whose events our unfiltered /chat/subscribe
                stream may not carry (2026-10 field test: with a fresh
                random session_id the ACK/user-echo stopped arriving
                entirely). device_id alone keeps the note in the device's
                conversation. Leave off unless Muse confirms the routing.
    endmenu

    menu "Robot V2 ADC Keys"
        config ROBOT_V2_ADC_KEYS
            bool "Enable Robot V2 dual-channel ADC keys"
            default n
            depends on ADC_KEY
            help
                Register S2/S3 on KEY1 and S4/S5 on KEY2 through the generic
                multi-channel adc_key SDK API.

        if ROBOT_V2_ADC_KEYS

        config ROBOT_KEY1_ADC_GPIO
            int "Robot V2 KEY1 ADC GPIO"
            range 0 71
            default 13

        config ROBOT_KEY1_ADC_CHAN
            int "Robot V2 KEY1 ADC channel"
            range 0 15
            default 15

        config ROBOT_KEY2_ADC_GPIO
            int "Robot V2 KEY2 ADC GPIO"
            range 0 71
            default 28

        config ROBOT_KEY2_ADC_CHAN
            int "Robot V2 KEY2 ADC channel"
            range 0 15
            default 4

        config ROBOT_KEY_S2_VOLTAGE_LOW
            int "S2 voltage lower bound (mV)"
            default 500

        config ROBOT_KEY_S2_VOLTAGE_HIGH
            int "S2 voltage upper bound (mV)"
            default 1500

        config ROBOT_KEY_S3_VOLTAGE_LOW
            int "S3 voltage lower bound (mV)"
            default 4500

        config ROBOT_KEY_S3_VOLTAGE_HIGH
            int "S3 voltage upper bound (mV)"
            default 6000

        config ROBOT_KEY_S4_VOLTAGE_LOW
            int "S4 voltage lower bound (mV)"
            default 500

        config ROBOT_KEY_S4_VOLTAGE_HIGH
            int "S4 voltage upper bound (mV)"
            default 1500

        config ROBOT_KEY_S5_VOLTAGE_LOW
            int "S5 voltage lower bound (mV)"
            default 4500

        config ROBOT_KEY_S5_VOLTAGE_HIGH
            int "S5 voltage upper bound (mV)"
            default 6000

        endif
    endmenu

    config BEKEN_KWS_MODEL_FROM_UDISK
        bool "Load Beken KWS model from U-disk/SD-NAND file"
        depends on BEKEN_KWS
        default n
        help
            When enabled, the beken_robot solution loads KWS .tflite models
            from 1:/kws_model/ at runtime and the built-in model arrays are
            not compiled into the kws_model library, saving flash space.

            When disabled, KWS uses SDK built-in model arrays.

    menu "Board: SD-NAND / USB Switch"
        config BOARD_SD_NAND_ENABLE
            bool "Enable on-board SD-NAND (U14 MKDV4GCL-ABB on SDIO1)"
            default n
            help
                BK7259 Robot V1 AI kit ships an on-board SD-NAND wired to
                SDIO controller 1 (P14~P19 = CLK/CMD/DAT0~DAT3). The chip
                is powered by NAND_VDD, which is gated by GPIO_53 on the
                main board. When this option is enabled, ap_main.c will
                pull NAND_VDD power gate high at boot and the SDIO driver
                will target controller 1.

                Make sure CONFIG_SDCARD / CONFIG_FATFS / CONFIG_FATFS_SDCARD
                and CONFIG_SDIO_USE_GROUP1 are also enabled when using this
                feature.

        config BOARD_SD_NAND_POWER_GPIO
            int "GPIO that gates NAND_VDD (SD-NAND power)"
            depends on BOARD_SD_NAND_ENABLE
            range 0 71
            default 53
            help
                GPIO index that controls the NAND_VDD power switch.
                On BK7259 Robot V1 AI kit, P53 gates NAND_VDD: pull
                high to power the SD-NAND chip on, low to power off.

        config BOARD_USB_SWITCH_ENABLE
            bool "Enable on-board USB-Switch CLI (P54 selects CH340 vs BK7259 USB)"
            default n
            help
                The Robot V1 board shares one Type-C connector between
                the CH340 USB-to-UART bridge (used as log/flash port) and
                BK7259's full-speed USB. A pair of FSW3157A 1:2 muxes is
                steered by GPIO SW_SEL (P54): low = CH340 (UART, default
                for log+download), high = BK7259 USB (e.g. USB MSC to
                copy assets to SD-NAND from a PC).

                When this option is enabled, ap_main.c drives SW_SEL low
                at boot and registers the `usbsw` CLI command to flip
                the mux to BK7259 USB on demand.

        config BOARD_USB_SWITCH_GPIO
            int "GPIO connected to SW_SEL of FSW3157A USB switch"
            depends on BOARD_USB_SWITCH_ENABLE
            range 0 71
            default 54
            help
                GPIO index that drives the SEL pin of U1/U4 (FSW3157A)
                USB switches on the Robot V1 board. Default P54.

        config BOARD_USB_SWITCH_USB_LEVEL
            int "GPIO level that routes Type-C to BK7259 USB (0 or 1)"
            depends on BOARD_USB_SWITCH_ENABLE
            range 0 1
            default 1
            help
                Per the FSW3157A truth table on Robot V1 schematic
                (Page 2, "USB Switch"): SEL=0 routes Type-C to channel 1
                (CH340/UART), SEL=1 routes it to channel 2 (BK7259 USB).
                Keep this at 1 unless the board has the mux pin swapped.

        # NOTE: SD-NAND is validated via the SDK's built-in `fatfstest`
        # CLI (ap/components/bk_cli/cli_fatfs.c, gated by CONFIG_FATFS).
        # CONFIG_SDCARD + CONFIG_FATFS + CONFIG_SDIO_USE_GROUP1 in this
        # project's defconfig is enough -- no project-local CLI needed.
        # See docs/sdio_on_bk7259.md §7.7 for why the SDK's legacy
        # CONFIG_SDIO_HOST / cli_sdio_host.c path can't be used on BK7259.
    endmenu
endmenu
```
