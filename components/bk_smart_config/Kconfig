## projects/secureboot_headset_lp/ap/config/bk7259_ap/defconfig
```kconfig
#
# secureboot_headset_lp AP defconfig
#

# platform
CONFIG_SOC_SMP=y
CONFIG_CPU_ID_OFFSET=2
CONFIG_SMP_CORE_CNT=2
# CONFIG_FREERTOS_V10 is not set
CONFIG_FREERTOS_SMP=y
CONFIG_SPE=0
CONFIG_SRAM_DIRECT_ADDR=y
CONFIG_SLAVE_HEART_BEAT=n
CONFIG_SUPPORT_WWDT=y
# CONFIG_SYSTICK_32K is not set
CONFIG_SPINLOCK_DYNAMIC_CNT=512
CONFIG_GENERAL_DMA=y
CONFIG_GENERAL_DMA_V2P6=y
CONFIG_DMA_LOGIC_CHAN_CNT=4
CONFIG_DMA_LOGIC_CHAN_ID_MIN=4
# L2 cache off: keep NS AP away from the PL310 window (Secure Shim probes it)
# CONFIG_L2_CACHE_ENABLE is not set
# SPI unused on this board (TP is I2C, LCD is MIPI)
# CONFIG_SPI is not set
# CONFIG_SPI_DMA is not set

# robot hardware
CONFIG_ADC_KEY=y
CONFIG_ROBOT_V2_ADC_KEYS=y
CONFIG_ROBOT_KEY1_ADC_GPIO=13
CONFIG_ROBOT_KEY1_ADC_CHAN=15
CONFIG_ROBOT_KEY2_ADC_GPIO=28
CONFIG_ROBOT_KEY2_ADC_CHAN=4
CONFIG_ROBOT_KEY_S2_VOLTAGE_LOW=500
CONFIG_ROBOT_KEY_S2_VOLTAGE_HIGH=1500
CONFIG_ROBOT_KEY_S3_VOLTAGE_LOW=4500
CONFIG_ROBOT_KEY_S3_VOLTAGE_HIGH=6000
CONFIG_ROBOT_KEY_S4_VOLTAGE_LOW=500
CONFIG_ROBOT_KEY_S4_VOLTAGE_HIGH=1500
CONFIG_ROBOT_KEY_S5_VOLTAGE_LOW=4500
CONFIG_ROBOT_KEY_S5_VOLTAGE_HIGH=6000
CONFIG_ADC_KEY_LONG_PRESS_MS=3000

# bluetooth
CONFIG_BLUETOOTH_HOST_ONLY=y
CONFIG_BLUETOOTH_AP=y
CONFIG_BT=y
CONFIG_BLUETOOTH_BTDM_COMPONENT_ENABLE=y
CONFIG_HFP_HF_DEMO=y
CONFIG_BLUETOOTH_BTDM_COMPONENT_BLE_GATT=y
CONFIG_BLUETOOTH_BTDM_COMPONENT_BLE_GATTS_TEST_ATTR=n
CONFIG_BLUETOOTH_BTDM_COMPONENT_BLE_HOGPD=n

# audio
CONFIG_AUDIO=y
CONFIG_AUD_DRIVER_V2=y
CONFIG_AUDIO_ADC=y
CONFIG_AUDIO_DAC=y
CONFIG_AUDIO_PLAY=y
CONFIG_AUDIO_RECORD=y
CONFIG_ADK=y
CONFIG_ADK_USE_PSRAM=y
CONFIG_ADK_EQ_ALGORITHM=y
CONFIG_ADK_MIX_ALGORITHM=y
CONFIG_ADK_ONBOARD_MIC_STREAM=y
CONFIG_ADK_ONBOARD_MIC_STREAM_V2=y
CONFIG_ADK_ONBOARD_SPEAKER_STREAM=y
CONFIG_ADK_ONBOARD_SPEAKER_STREAM_SUPPORT_MULTIPLE_SOURCE=y
CONFIG_ADK_ONBOARD_SPEAKER_STREAM_V2=y
CONFIG_ADK_RAW_STREAM=y
CONFIG_ADK_SBC_DECODER=y
CONFIG_ADK_SBC_ENCODER=y
CONFIG_ADK_AAC_DECODER=y
CONFIG_ADK_VFS_STREAM=y
CONFIG_PLAYER_SERVICE=y
CONFIG_PLAYER_SERVICE_SUPPORT_ARRAY_STREAM=y
CONFIG_PLAYER_SERVICE_SUPPORT_VFS_STREAM=y
CONFIG_PLAYER_SERVICE_SUPPORT_MP3_DECODER=y
CONFIG_PLAYER_SERVICE_SUPPORT_WAV_DECODER=y

# PM
CONFIG_CPU_DEFAULT_FREQ_60M=n
CONFIG_FREERTOS_USE_TICKLESS_IDLE=2
CONFIG_GPIO_WAKEUP_SUPPORT=y
CONFIG_GPIO_DYNAMIC_WAKEUP_SUPPORT=y
CONFIG_PM_AP_SUBPOWER_DOMAIN_DEFAULT_DISABLE=y
CONFIG_PM_AP_CPU_FRQ_DEFAUL=y
CONFIG_PSRAM_DATA_RETENTION_ENABLE=y
CONFIG_PM_AP_FAST_BOOT_ENABLE=y
CONFIG_BLUETOOTH_SUPPORT_AP_PWD_RETENTION=y

# display
CONFIG_BK_DISPLAY=y
CONFIG_BK_PERIPHERAL=y
# app_display MIPI panel + DPU helpers; H264 encode off (no camera on headset)
CONFIG_MULTIMEDIA_DEVICE_SERVICE=y
# CONFIG_MULTIMEDIA_H264_ENCODE is not set
CONFIG_DSI_DRIVER=y
CONFIG_DPU_DRIVER=y
CONFIG_MIPI_DSI=y
CONFIG_FRAME_BUFFER=y
CONFIG_VG_LITE_GPU=y
# NS address = Secure base 0x4c280000 + SOC_ADDR_OFFSET(0x10000000)
CONFIG_VG_LITE_GPU_BASE_ADDRESS=0x5c280000
CONFIG_VG_LITE_GPU_COMMAND_BUFFER_SIZE=0x2000
CONFIG_VG_LITE_GPU_TESS_WIDTH=200
CONFIG_VG_LITE_GPU_TESS_HEIGHT=160
CONFIG_LCD_DSI=y
CONFIG_LCD_JD9855_MIPI_320x385=y
CONFIG_TP=y
CONFIG_TP_CST9217=y
CONFIG_TP_RST_PIN=29
CONFIG_TP_INT_PIN=30
CONFIG_TP_I2C_SDA_PIN=71
CONFIG_TP_I2C_SCL_PIN=70
CONFIG_LVGL=y
CONFIG_LVGL_V9=y
CONFIG_LVGL_TASK_PRIORITY=4
CONFIG_LVGL_TASK_STACK_SIZE=8192
CONFIG_LVGL_FRAME_BUFFER_NUM=2

# system
CONFIG_FREERTOS_USE_QUEUE_SETS=y
CONFIG_FREERTOS_POSIX=y
CONFIG_GET_UID_ENABLE=y
CONFIG_VFS=y
CONFIG_EASY_FLASH_V4=y
CONFIG_CJSON_USE=y
CONFIG_LITTLEFS=y
CONFIG_LITTLEFS_NO_CONFIG_PARTITION=y
CONFIG_MEDIA_SERVICE=y
CONFIG_MEMDUMP_ALL=y
CONFIG_DUMP_UART_MEM_ENCODING_ASCII=y
CONFIG_DUMP_BY_LOG_UART=y
CONFIG_LOG_TASK_STACK_SIZE=2048
CONFIG_TASK_WDT=n
CONFIG_AT=y
CONFIG_DEFAULT_AT_PORT=5

# peripheral
CONFIG_UART_ERR_INTERRUPT=y
CONFIG_UART2_TX_PIN=69
CONFIG_UART5=y
CONFIG_UART5_TX_PIN=65
CONFIG_UART5_RX_PIN=64
CONFIG_PWM=y
CONFIG_USR_GPIO_CFG_EN=y

# storage
# Not used: the product only does BT audio + UI, there is no SD card, no SD-NAND
# and no USB mass-storage path. Keeping them off also stops the SDIO host/card
# from drawing current while the system is idle.
# CONFIG_SDCARD is not set
# CONFIG_FATFS is not set
# CONFIG_FATFS_SDCARD is not set
# CONFIG_SDCARD_HOST_ID is not set
# CONFIG_SDCARD_BUSWIDTH_4LINE is not set
# CONFIG_BOARD_SD_NAND_ENABLE is not set
# CONFIG_BOARD_SD_NAND_POWER_GPIO is not set
# CONFIG_BOARD_USB_SWITCH_ENABLE is not set
# CONFIG_BOARD_USB_SWITCH_GPIO is not set
# CONFIG_VFS_TEST is not set
# CONFIG_USB_DEVICE is not set
# CONFIG_USBD_MSC is not set
CONFIG_USB_RISCV_BRIDGE=n

# memory
# os_malloc defaults to PSRAM heap; 8KB SRAM heap kept for early boot
CONFIG_OS_HEAP_USE_PSRAM=y
# stacks/queues in PSRAM; rtos_create_hsram_thread users stay in HSRAM
CONFIG_TASK_STACK_IN_PSRAM=n
CONFIG_QUEUE_IN_PSRAM=n

# disabled
# CONFIG_SECURE_OTA_OVERWRITE is not set
# CONFIG_OTA_FUNCTION is not set
# CONFIG_OTA_HTTP is not set
# CONFIG_ALL_CODE_IN_PSRAM is not set
# CONFIG_OTA_HTTP is not set
# CONFIG_BK_SMART_CONFIG is not set
# CONFIG_ADK_VFS_UTIL is not set
# CONFIG_AE_ENABLE_PA_CNTRL is not set
# CONFIG_UART_RX_DMA is not set
# CONFIG_UART_RX_DMA_KFIFO_SIZE is not set
# CONFIG_AP_SECURE_CACHE_NSC is not set
```

## projects/secureboot_headset_lp/cp/config/bk7259/defconfig
```kconfig
#
# secureboot_headset_lp CP defconfig
#

# platform
CONFIG_SOC_SMP=n
CONFIG_CPU_ID_OFFSET=0
CONFIG_SMP_CORE_CNT=2
CONFIG_FREERTOS_V10=y
CONFIG_FREERTOS_SMP=n
CONFIG_SPINLOCK=y
CONFIG_FREERTOS_ALLOW_OS_API_IN_IRQ_DISABLED=y
CONFIG_SLAVE_HEART_BEAT=y
CONFIG_SUPPORT_WWDT=y
CONFIG_SECURITY_FIRMWARE=y
CONFIG_SPE=0
CONFIG_SRAM_DIRECT_ADDR=y
CONFIG_EASY_FLASH=n
CONFIG_AT_CMD=y
# CONFIG_MEM_DEBUG is not set

# tf-m
CONFIG_TFM=y
CONFIG_TFM_PROFILE="profile_medium"
CONFIG_TFM_BUILD_TYPE="minsizerel"
CONFIG_TFM_BL2="ON"
CONFIG_TFM_ISOLATION_LEVEL=2
CONFIG_TFM_TEST_S="OFF"
CONFIG_TFM_TEST_NS="OFF"
CONFIG_TFM_FPGA="OFF"
# INFO for debugging, lower for production
CONFIG_TFM_LOG_LEVEL="INFO"
CONFIG_TFM_BL2_LOG_LEVEL="INFO"
CONFIG_BL2_UPGRADE_STRATEGY="OVERWRITE_ONLY"
CONFIG_CPU0_SPE_RAM_SIZE=0x14000
CONFIG_TFM_HEAP_SIZE=0x6000
CONFIG_TFM_CRYPTO=y
# CONFIG_TFM_PS is not set
# CONFIG_TFM_FWU is not set
CONFIG_INITIAL_ATTESTATION=n
CONFIG_SUPPORT_MULTICORE=y
CONFIG_TFM_AP_BOOT_NSC=y
CONFIG_TFM_AP_CACHE_NSC=y
CONFIG_TFM_SLEEP_RETENTION_NSC=y
# CONFIG_TFM_REG_ACCESS_NSC is not set
CONFIG_PSA_MBEDTLS=y
# CONFIG_TRUSTENGINE is not set
CONFIG_SW_CRYPTO=y
# OTP and TE200 share the ENCP power domain, keep it always-on
CONFIG_AON_ENCP=y

# psram
# data retention only, NOT used as system memory
CONFIG_PSRAM=y
# CONFIG_PSRAM_AS_SYS_MEMORY is not set
# CONFIG_PSRAM_WRITE_THROUGH is not set
# CONFIG_PSRAM_CALIBRATE is not set
# CONFIG_PSRAM_TEST is not set
# CONFIG_USE_PSRAM_HEAP_AT_SRAM_OOM is not set

# PM
CONFIG_CPU_DEFAULT_FREQ_60M=n
CONFIG_FREERTOS_USE_TICKLESS_IDLE=2
CONFIG_PM_AP_POWERDOWN_WHEN_LV=y
CONFIG_PM_ONLY_CP_ENABLE=y
CONFIG_DEEP_LV=y
CONFIG_PM_LV_SLEEP_ENABLE=y
CONFIG_DEEP_LV_DEBUG_GPIO=n
CONFIG_DEEP_LV_DEBUG_LOG=n
CONFIG_AON_RTC=y
CONFIG_GPIO_WAKEUP_SUPPORT=y
CONFIG_GPIO_DYNAMIC_WAKEUP_SUPPORT=y
CONFIG_TOUCH=n
CONFIG_TOUCH_TEST=n
CONFIG_PM_POWER_VOTE_RECORD=n
CONFIG_PM_CLOCK_VOTE_RECORD=n
CONFIG_CKMN_TEST=n
CONFIG_OPTIMIZE_AON_CURRENT=y
CONFIG_AON_LDO_SEL=2
CONFIG_DEBUG_VERSION=n
CONFIG_PM_CURRENT_OPTIMIZE_XTAL_RX_TX_ANABUF=n
CONFIG_PM_CP_PERI_CLK_DEFAULT_OFF=n
CONFIG_PM_XTAL_RX_TX_ANABUF_DEFAULT_OFF=n
CONFIG_PM_SLEEP_WAKE_TIME_HARDWARE_OR_BOOTLOADER=1190

# wifi
CONFIG_STA_PS=y

# bluetooth
CONFIG_BLUETOOTH_SUPPORT_LPO_ROSC=y
CONFIG_BLE_LV_SUPPORT=y
CONFIG_BLUETOOTH=y
CONFIG_BT=y
CONFIG_BTDM_CONTROLLER_ONLY=y

# retention
CONFIG_PSRAM_DATA_RETENTION_ENABLE=y
CONFIG_PM_AP_FAST_BOOT_ENABLE=y
CONFIG_BLUETOOTH_SUPPORT_AP_PWD_RETENTION=y
```
