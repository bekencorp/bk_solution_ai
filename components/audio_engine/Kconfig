## components/audio_engine/Kconfig
```kconfig
# KCONFIG_GROUP: Solution & Product
menu "Audio Engine"
	config BK_AUDIO_ENGINE
		bool "enable audio engine"
		default y

	config AE_AUDIO_FRAME_DURATION_MS
		int "default audio frame duration in ms"
		range 20 60
		default 20

	config AE_SEND_AUDIO_WITHOUT_ASR_RESULT
		bool "Send audio without checking ASR result"
		depends on BK_NETWORK_ENGINE
		default n

	config AE_AUDIO_ADC_SAMP_RATE
		int "ADC sample rate"
		default 16000

	config AE_AUDIO_DAC_SAMP_RATE
		int "DAC sample rate"
		default 16000

	choice AE_AUDIO_ENCODER
		prompt "Audio encoder type"
		default AE_AUDIO_ENCODER_G722
		config AE_AUDIO_ENCODER_G722
			bool "G722"
			depends on ADK_G722_ENCODER && VOICE_SERVICE_G722_ENCODER
		config AE_AUDIO_ENCODER_G711A
			bool "G711A"
			depends on ADK_G711_ENCODER && VOICE_SERVICE_G711_ENCODER
		config AE_AUDIO_ENCODER_G711U
			bool "G711U"
			depends on ADK_G711_ENCODER && VOICE_SERVICE_G711_ENCODER
		config AE_AUDIO_ENCODER_OPUS
			bool "OPUS"
			depends on ADK_OPUS_ENCODER && VOICE_SERVICE_OPUS_ENCODER
		config AE_AUDIO_ENCODER_PCM
			bool "PCM"
	endchoice

	config AE_AUDIO_ENCODER_TYPE
		string
		default "G722" if AE_AUDIO_ENCODER_G722
		default "G711A" if AE_AUDIO_ENCODER_G711A
		default "G711U" if AE_AUDIO_ENCODER_G711U
		default "OPUS" if AE_AUDIO_ENCODER_OPUS
		default "PCM" if AE_AUDIO_ENCODER_PCM
		default "G722"

	choice AE_AUDIO_DECODER
		prompt "Audio decoder type"
		default AE_AUDIO_DECODER_G722
		config AE_AUDIO_DECODER_G722
			bool "G722"
			depends on ADK_G722_DECODER && VOICE_SERVICE_G722_DECODER
		config AE_AUDIO_DECODER_G711A
			bool "G711A"
			depends on ADK_G711_DECODER && VOICE_SERVICE_G711_DECODER
		config AE_AUDIO_DECODER_G711U
			bool "G711U"
			depends on ADK_G711_DECODER && VOICE_SERVICE_G711_DECODER
		config AE_AUDIO_DECODER_OPUS
			bool "OPUS"
			depends on ADK_OPUS_DECODER && VOICE_SERVICE_OPUS_DECODER
		config AE_AUDIO_DECODER_PCM
			bool "PCM"
	endchoice

	config AE_AUDIO_DECODER_TYPE
		string
		default "G722" if AE_AUDIO_DECODER_G722
		default "G711A" if AE_AUDIO_DECODER_G711A
		default "G711U" if AE_AUDIO_DECODER_G711U
		default "OPUS" if AE_AUDIO_DECODER_OPUS
		default "PCM" if AE_AUDIO_DECODER_PCM
		default "G722"

	config AE_ENABLE_PA_CNTRL
		bool "enable PA control"
		default y

	config AE_PA_CNTRL_GPIO
		int "PA control GPIO"
		depends on AE_ENABLE_PA_CNTRL
		default 50
		range 0 100

	config AE_PA_ON_LEVEL
		int "PA on level"
		depends on AE_ENABLE_PA_CNTRL
		default 1
		range 0 1

	config AE_PA_ON_DELAY
		int "PA on delay in ms"
		depends on AE_ENABLE_PA_CNTRL
		default 10

	config AE_PA_OFF_DELAY
		int "PA off delay in ms"
		depends on AE_ENABLE_PA_CNTRL
		default 30

	config AE_DEFAULT_DIG_GAIN
		hex "audio dac digital gain"
		default 0x16

	config AE_DEFAULT_ANA_GAIN
		hex "audio dac analog gain"
		default 0xA

	config AE_SUPPORT_PROMPT_TONE
		depends on ADK_ONBOARD_SPEAKER_STREAM_SUPPORT_MULTIPLE_SOURCE && PLAYER_SERVICE && BK_AUDIO_ENGINE
		bool "Enable audio engine support playback prompt tone"
		default n

	choice AE_PROMPT_TONE_SOURCE
		depends on AE_SUPPORT_PROMPT_TONE
		prompt "Select audio engine prompt tone Source"
		default AE_PROMPT_TONE_SOURCE_ARRAY

		config AE_PROMPT_TONE_SOURCE_ARRAY
		depends on PLAYER_SERVICE_SUPPORT_ARRAY_STREAM
		bool "Select prompt tone stored in array"

		config AE_PROMPT_TONE_SOURCE_VFS
		depends on PLAYER_SERVICE_SUPPORT_VFS_STREAM
		bool "Select prompt tone stored in vfs file system"
	endchoice

	choice AE_PROMPT_TONE_DECODER_TYPE
		depends on AE_SUPPORT_PROMPT_TONE
		prompt "Select audio engine prompt tone decoder type"
		default AE_PROMPT_TONE_DECODER_WAV

		config AE_PROMPT_TONE_DECODER_PCM
		bool "Select PCM Prompt Tone"

		config AE_PROMPT_TONE_DECODER_MP3
		depends on PLAYER_SERVICE_SUPPORT_MP3_DECODER
		bool "Select MP3 Prompt Tone"

		config AE_PROMPT_TONE_DECODER_WAV
		depends on PLAYER_SERVICE_SUPPORT_WAV_DECODER
		bool "Select WAV Prompt Tone"
	endchoice

endmenu
```

## components/avdk_nn_module/Kconfig
```kconfig
# KCONFIG_GROUP: Solution & Product
menu "AVDK NN Module"

	config TFLM_YOLOFACE_V1
		depends on TFLITE_MICRO
		bool "Enable tflm YOLOFACE_V1"
		default n

	config TFLM_PALM_DETECTION_V1
		depends on TFLITE_MICRO
		bool "Enable tflm PALM_V1"
		default n

	config TFLM_HAND_GESTURE_DETECTION_V1
		depends on TFLITE_MICRO
		bool "Enable tflm HAND_GESTURE_DETECTION_V1"
		default n

	config TFLM_FACE_RECOG_V1
		depends on TFLITE_MICRO
		bool "Enable tflm FACE_RECOG_V1"
		default n

endmenu
```

## components/bk_app_event/Kconfig
```kconfig
# KCONFIG_GROUP: Solution & Product
menu "app_event"
	  config APP_EVT
        bool "Enable APP_EVT"
        default y

endmenu
```

## components/bk_countdown/Kconfig
```kconfig
# KCONFIG_GROUP: Solution & Product
menu "countdown"
	  config COUNTDOWN
        bool "Enable COUNTDOWN"
        default n
endmenu
```

## components/bk_factory_config/Kconfig
```kconfig
# KCONFIG_GROUP: Solution & Product
menu "BK Factory Config"
	  config BK_FACTORY_CONFIG
        bool "Enable BK factory config"
        default y
endmenu
```

## components/bk_led_blink/Kconfig
```kconfig
# KCONFIG_GROUP: Solution & Product
menu "led_blink"
	  config LED_BLINK
        bool "Enable LED_BLINK"
        default n
endmenu
```

## components/bk_smart_config/Kconfig
```kconfig
menu "BK Smart Config"
	config BK_SMART_CONFIG
		bool "Enable beken sramt config module"
		default n
endmenu
```

## components/multimedia_device_service/Kconfig
```kconfig
# KCONFIG_GROUP: Solution & Product
menu "Multimedia device service (camera/display/gpu/h264 helpers)"
    config MULTIMEDIA_DEVICE_SERVICE
        bool "Enable multimedia_device_service helpers"
        default y
        help
            Provides high-level helpers (app_camera/app_display/app_gpu and
            optional app_codec for H.264 encoding) ported from the doorbell
            reference project for the MIPI CSI camera + ISP + GPU + DPU
            pipeline used in beken_robot.

    config MULTIMEDIA_H264_ENCODE
        bool "Enable H.264 encode of MIPI camera (HW flexa)"
        default y
        depends on MULTIMEDIA_DEVICE_SERVICE
        help
            Compile app_codec.c + multimedia_img_manager.c so the MIPI
            camera ISP MP NV12 stream can be encoded to H.264 via the
            hardware flexa encoder. The encoded H.264 frames are stored
            in a producer/consumer queue exposed via
            bk_encoded_complete_data_request() / _free_request() so that
            transmitter modules (e.g. WiFi/RTP) can consume them without
            having to know about the camera/encoder details.
endmenu
```

## components/network_engine/Kconfig
```kconfig
# KCONFIG_GROUP: Solution & Product
menu "net_transfer"
	config BK_NETWORK_ENGINE
		bool "Enable BEKEN Network Transfer"
		default y

	config BK_WSS_TRANS
		bool "Enable Beken Websocket Transmit for AI"
		default n

	config BK_WSS_TRANS_NOPSRAM
		bool "Enable Websocket Transmit for AI without PSRAM"
		default n

	config BK_TRANS_EN
		bool "Enable BK network transfer backend for network_engine"
		depends on BK_NTWK_TRANSFER
		default y
		help
			Enable the network_engine adapter for the BK SDK
			bk_network_transfer TCP/UDP/CS2 service.

	config VOLC_ENABLE_VISION_BY_DEFAULT
		bool "Enable visual recognition for volc_rtc by default"
		default n

	config VOLC_ENABLE_SUBTITLE_BY_DEFAULT
		bool "Enable subtitle for volc_rtc by default"
		default n

	config SENSENOVA_ENABLE
		bool "Enable sensenova with aogra by default"
		default n

	config STARTUP_AGENT_FROM_BK_SERVER
		bool "Start agent from BK server if enable, otherwise start agent from Custom-built server"
		default y
endmenu
```

## components/robot_ctrl_service/Kconfig
```kconfig
# KCONFIG_GROUP: Solution & Product
menu "robot_ctrl_service"
config BK_ROBOT_CTRL_SERVICE
    bool "Enable BK7259 robot control service"
    default n
    depends on BK_ROBOT_LAN_NET

config BK_ROBOT_CTRL_TIMEOUT_MS
    int "Robot control command timeout"
    default 500
    depends on BK_ROBOT_CTRL_SERVICE

config BK_ROBOT_SESSION_TIMEOUT_MS
    int "Robot control session timeout"
    default 5000
    depends on BK_ROBOT_CTRL_SERVICE

config BK_ROBOT_AP_KEEPALIVE
    bool "Enable robot AP keepalive state machine"
    default n
    depends on BK_ROBOT_CTRL_SERVICE

config BK_ROBOT_AP_KEEPALIVE_IDLE_MS
    int "Robot AP keepalive idle timeout"
    default 5000
    depends on BK_ROBOT_AP_KEEPALIVE

config BK_ROBOT_SESSION_WAKEUP_TIMEOUT_MS
    int "Robot session wakeup timeout"
    default 5000
    depends on BK_ROBOT_CTRL_SERVICE

config BK_ROBOT_AUDIO_BUSY_DISABLE_MOTION
    bool "Disable motion while audio talk is enabled"
    default y
    depends on BK_ROBOT_CTRL_SERVICE
endmenu
```

## components/robot_lan_net/Kconfig
```kconfig
menu "robot_lan_net"
    config BK_ROBOT_LAN_NET
        bool "Enable BK7259 robot LAN network"
        default n
        depends on LWIP
        depends on BK_NTWK_TRANSFER
        depends on NTWK_CLIENT_SERVICE_ENABLE

    config BK_ROBOT_LAN_DISCOVERY_PORT
        int "Robot LAN discovery listen port"
        default 52110
        depends on BK_ROBOT_LAN_NET

    config BK_ROBOT_LAN_DISCOVERY_STACK_SIZE
        int "Robot LAN discovery task stack size"
        default 4096
        depends on BK_ROBOT_LAN_NET
endmenu
```

## components/robot_video_service/Kconfig
```kconfig
# KCONFIG_GROUP: Solution & Product
menu "robot_video_service"
    config BK_ROBOT_VIDEO_SERVICE
        bool "Enable BK7259 robot video service"
        default n
        depends on BK_VIDEO_ENGINE

    config BK_ROBOT_VIDEO_WIDTH
        int "Robot video width"
        default 640
        depends on BK_ROBOT_VIDEO_SERVICE

    config BK_ROBOT_VIDEO_HEIGHT
        int "Robot video height"
        default 480
        depends on BK_ROBOT_VIDEO_SERVICE

    config BK_ROBOT_VIDEO_FPS
        int "Robot video fps"
        default 20
        depends on BK_ROBOT_VIDEO_SERVICE

    config BK_ROBOT_VIDEO_BITRATE_KBPS
        int "Robot video bitrate kbps"
        default 1000
        depends on BK_ROBOT_VIDEO_SERVICE
endmenu
```

## components/video_engine/Kconfig
```kconfig
# KCONFIG_GROUP: Solution & Product
menu "video_engine"

	config BK_VIDEO_ENGINE
	bool "enable video engine"
	default y
		
	choice VIDEO_ENGINE_USE_CAMERA_TYPE
		prompt "Select video engine use camera type"
		default VIDEO_ENGINE_USE_DVP_CAMERA

		config VIDEO_ENGINE_USE_DVP_CAMERA
		bool "Select DVP camera"
		help
			Select DVP camera

		config VIDEO_ENGINE_USE_MIPI_CAMERA
		bool "Select MIPI CSI camera"
		depends on ISP && MIPI_CSI && CSI_CAMERA
		help
			Select BK7259 MIPI CSI camera through ISP and H.264 encoder.

		config VIDEO_ENGINE_USE_UVC_CAMERA
		bool "Select UVC camera"
		help
			Select UVC camera
	endchoice

	choice VIDEO_ENGINE_IMAGE_FORMAT
		prompt "Select video engine image format"
		default VIDEO_ENGINE_JPEG_FORMAT

		config VIDEO_ENGINE_JPEG_FORMAT
		bool "Select JPEG image format"
		help
			Select JPEG image format

		config VIDEO_ENGINE_H264_FORMAT
		bool "Select H264 image format"
		help
			Select H264 image format
	endchoice

	config VIDEO_ENGINE_RESOLUTION_WIDTH
	int "Default size of the width"
	range 1 2000
	default 1280
	help
		Set the size of the resolution width, The recommended value is 1280 .

	config VIDEO_ENGINE_RESOLUTION_HEIGHT
	int "Default size of the height"
	range 1 2000
	default 720
	help
		Set the size of the resolution height, The recommended value is 720 .

	config VIDEO_ENGINE_MIPI_SENSOR_WIDTH
	int "MIPI sensor width"
	depends on VIDEO_ENGINE_USE_MIPI_CAMERA
	range 1 2000
	default 1280
	help
		Set the MIPI sensor input width.

	config VIDEO_ENGINE_MIPI_SENSOR_HEIGHT
	int "MIPI sensor height"
	depends on VIDEO_ENGINE_USE_MIPI_CAMERA
	range 1 2000
	default 720
	help
		Set the MIPI sensor input height.

	config VIDEO_ENGINE_MIPI_SENSOR_FPS
	int "MIPI sensor FPS"
	depends on VIDEO_ENGINE_USE_MIPI_CAMERA
	range 1 120
	default 25
	help
		Set the MIPI sensor input frame rate.

endmenu
```

## projects/baf_example/ap/Kconfig.projbuild
```kconfig
menu "LVGL BAF Example Configuration"

choice
    prompt "BAF example playback backend"
    default BAF_EXAMPLE_MODE_RAW
    help
      Select how the BAF animation is played and shown. RAW drives the closed
      bk_baf decoder + GPU compositor directly and flushes straight to the DPU
      panel (no LVGL). LVGL renders through the lv_baf widget.

config BAF_EXAMPLE_MODE_RAW
    bool "Raw bk_baf (no LVGL): decode + GPU compose + direct DPU flush"

config BAF_EXAMPLE_MODE_LVGL
    bool "lv_baf LVGL widget"
    select LVGL

endchoice

choice
    prompt "BAF RAW render backend"
    depends on BAF_EXAMPLE_MODE_RAW
    default BAF_RAW_RENDER_GPU
    help
      Compositor used by the RAW backend. GPU uses VG-Lite (bk_baf_open brings
      it up in the library); CPU uses Helium/MVE with no GPU init. In LVGL mode the
      backend is chosen automatically from whether LVGL initialised the GPU.

config BAF_RAW_RENDER_GPU
    bool "GPU (VG-Lite)"

config BAF_RAW_RENDER_CPU
    bool "CPU (Helium)"

endchoice

endmenu
```
